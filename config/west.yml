## config/west.yml
```yaml
manifest:
  remotes:
    - name: zmkfirmware
      url-base: https://github.com/zmkfirmware
    - name: kloir-z
      url-base: https://github.com/kloir-z
    - name: urob
      url-base: https://github.com/urob
  projects:
    - name: zmk
      remote: zmkfirmware
      revision: main
      import: app/west.yml
    - name: zmk-pmw3610-driver
      remote: kloir-z
      revision: scroll-acceleration-feature
    - name: zmk-auto-layer
      remote: urob
      revision: main
  self:
    path: config
```
